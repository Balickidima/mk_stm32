# STM32F401 register map
File version: 1.0
STM32F401 MCU
Registers are 32-bit, read-write, no defined reset value unless marked. A register's access mark holds for its fields unless they carry their own. Offsets are from the block's base; lines under a group give offsets from that group; [hi:lo] are bit positions; {n}, {i} and the like mark numbered series; 'fields as' and 'values as' point back to an identical list; <NAME> marks a mode.

## Memory map
0x40020000 GPIOA — General Purpose I/O Port A
0x40020800 GPIOC — General Purpose I/O Port C
0x40023800 RCC — Reset and Clock Control

## GPIOA — General Purpose I/O Port A
Base 0x40020000
Same registers: GPIOC 0x40020800
0x00 MODER — GPIO port mode register
0x04 OTYPER — GPIO port output type register
0x08 OSPEEDR — GPIO port output speed register
0x0C PUPDR — GPIO port pull-up/pull-down register
0x10 IDR ro — GPIO port input data register
0x14 ODR — GPIO port output data register
0x18 BSRR wo — GPIO port bit set/reset register
